#include "klor.dtsi"

&kscan0 {
    /* DEFINE LEFT HALF COLUMN PINS HERE */
    col-gpios
		= <&pro_micro 18 GPIO_ACTIVE_HIGH>
		, <&pro_micro 15 GPIO_ACTIVE_HIGH>
		, <&pro_micro 14 GPIO_ACTIVE_HIGH>
		, <&pro_micro 16 GPIO_ACTIVE_HIGH>
		, <&pro_micro 10 GPIO_ACTIVE_HIGH>
		;
};   

&left_encoder {
	status = "disabled";
};
