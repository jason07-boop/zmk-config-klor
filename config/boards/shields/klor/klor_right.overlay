#include "klor.dtsi"

&default_transform {
	col-offset = <5>;
};

&kscan0 {
    /* DEFINE RIGHT HALF COLUMN PINS HERE (Must match right PCB wiring) */
    col-gpios
		= <&pro_micro 18 GPIO_ACTIVE_HIGH>
		, <&pro_micro 15 GPIO_ACTIVE_HIGH>
		, <&pro_micro 14 GPIO_ACTIVE_HIGH>
		, <&pro_micro 16 GPIO_ACTIVE_HIGH>
		, <&pro_micro 10 GPIO_ACTIVE_HIGH>
		;
};

&right_encoder {
	status = "disabled";
};
